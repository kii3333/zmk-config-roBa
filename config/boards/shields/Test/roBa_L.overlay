#include "roBa.dtsi"

&kscan0 {
        compatible = "zmk,keyboard";  // 追加
        row-gpios  // 追加（適切なピンに変更する必要あり）
            = <&xiao_d 1 GPIO_ACTIVE_HIGH>
            , <&xiao_d 2 GPIO_ACTIVE_HIGH>
            , <&xiao_d 3 GPIO_ACTIVE_HIGH>
            , <&xiao_d 6 GPIO_ACTIVE_HIGH>
            ;

        col-gpios
            = <&xiao_d 10 GPIO_ACTIVE_HIGH>
            , <&xiao_d 9 GPIO_ACTIVE_HIGH> 
            , <&xiao_d 8 GPIO_ACTIVE_HIGH> 
            , <&xiao_d 7 GPIO_ACTIVE_HIGH> 
            , <&gpio0 10 GPIO_ACTIVE_HIGH>
            , <&gpio0 9 GPIO_ACTIVE_HIGH>
            ;
};

&left_encoder {
    status = "okay";
};
